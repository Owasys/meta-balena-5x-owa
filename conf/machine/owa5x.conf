## conf/machine/owa5x.conf
```bitbake
#@TYPE: Machine
#@NAME: owa5x
#@SOC: i.MX8 MP
#@DESCRIPTION: Machine configuration for Owasys Cetus owa5x
#@MAINTAINER: Alvaro Guzman <alvaro.guzman@owasys.com>

 
require conf/machine/include/imx-base.inc
require conf/machine/include/tune-cortexa53.inc

# Kernel configuration
PREFERRED_PROVIDER_virtual/kernel ??= "linux-owasys-owa5x"
KERNEL_DEVICETREE = "freescale/imx8mp-owa5x.dtb "
KERNEL_CONFIG = "owa5x_config.R1"

KERNEL_IMAGETYPE = "Image"
RDEPENDS_${KERNEL_PACKAGE_NAME}-base = ""

# U-Boot configuration
PREFERRED_PROVIDER_u-boot ??= "u-boot-owasys"
PREFERRED_PROVIDER_virtual/bootloader ??= "u-boot-owasys"
PREFERRED_PROVIDER_imx-atf ??= "imx-atf-owasys"
SPL_BINARY = "spl/u-boot-spl.bin"
UBOOT_DTB_NAME ?= "imx8mp-owa5x.dtb"
UBOOT_MAKE_TARGET = ""
UBOOT_SUFFIX = "bin"

# Used to define the U-Boot defconfig for different board variants. The naming
# is here as a safeguard mechanism so that a user doesn't build and flash the
# wrong configuration.
#
# This method will be optimized in the future, but for now, use this variable to
# define the defconfig to be built.

UBOOT_CONFIG ??= "imx8mp_owa5x"
UBOOT_CONFIG[imx8mp_owa5x] = "imx8mp_owa5x_defconfig"

IMAGE_BOOTLOADER = "imx-boot-owasys"
ATF_PLATFORM = "imx8mp"
IMXBOOT_TARGETS = "flash_evk"
IMX_BOOT_SOC_TARGET = "iMX8MP"

DDR_FIRMWARE_NAME = "\
    lpddr4_pmu_train_1d_imem_202006.bin \
    lpddr4_pmu_train_1d_dmem_202006.bin \
    lpddr4_pmu_train_2d_imem_202006.bin \
    lpddr4_pmu_train_2d_dmem_202006.bin \
"
# wic support
WKS_FILE = "sdimage-bootpart.wks"

MACHINE_FEATURES += " wifi bluetooth"

SDCARD_ROOTFS = "${DEPLOY_DIR_IMAGE}/${IMAGE_NAME}.rootfs.ext4"
IMAGE_FSTYPES = " ext4"

hostname_pn-base-files = "Cetus"
```
